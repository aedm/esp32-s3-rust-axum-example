## sdkconfig.defaults
```kconfig
# CONFIG_LOG_DEFAULT_LEVEL_VERBOSE=y
# CONFIG_LOG_DEFAULT_LEVEL_INFO=y
CONFIG_LOG_DEFAULT_LEVEL=CONFIG_LOG_DEFAULT_LEVEL_INFO
#CONFIG_LOG_DEFAULT_LEVEL=CONFIG_LOG_DEFAULT_LEVEL_VERBOSE

# Tokio's async runtime needs more stack than the default 8192 bytes.
CONFIG_ESP_MAIN_TASK_STACK_SIZE=32768

CONFIG_LWIP_MAX_SOCKETS=16
```
